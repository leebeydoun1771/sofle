## boards/shields/sofle_ergomech/Kconfig.defconfig
```kconfig
# Copyright (c) 2020 Ryan Cross
# SPDX-License-Identifier: MIT

if SHIELD_SOFLE_ERGOMECH_LEFT

config ZMK_KEYBOARD_NAME
    default "Ergomech Sofle"

config ZMK_SPLIT_ROLE_CENTRAL
    default y

endif

if SHIELD_SOFLE_ERGOMECH_LEFT || SHIELD_SOFLE_ERGOMECH_RIGHT

config ZMK_SPLIT
    default y

endif
```
